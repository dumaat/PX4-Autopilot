## src/drivers/osd/Kconfig
```kconfig
menu "OSD"
    menuconfig COMMON_OSD
        bool "Common OSD drivers"
        default y
        select DRIVERS_OSD_ATXXXX
        select DRIVERS_OSD_MSP_OSD
        ---help---
            Enable default set of OSD drivers
    rsource "*/Kconfig"
endmenu
```
